## beaglebone/buildroot/package/libolm/Config.in
```kconfig
config BR2_PACKAGE_LIBOLM
    bool "libolm"
    help
      libolm is a C library for implementing the Olm and Megolm cryptographic ratchets.
```

## beaglebone/buildroot/package/userapps/Config.in
```kconfig
source "package/userapps/greeting/Config.in"
source "package/userapps/logs/Config.in"
```

## beaglebone/buildroot/package/userapps/logs/Config.in
```kconfig
config BR2_PACKAGE_LOGS
	bool "logs"
	help
  	  simple log program from Buildroot.
```

## beaglebone/buildroot/package/userapps/userAppsInfo/Config.in
```kconfig
config BR2_PACKAGE_USERAPPSINFO
	bool "userAppsInfo"
	help
  	  provides the list of user defined application.
```

## beaglebone/buildroot/package/userhello/Config.in
```kconfig
config BR2_PACKAGE_USERHELLO
	bool "userhello"
	help
  		Ein einfaches userHello World Programm für Buildroot.
```
